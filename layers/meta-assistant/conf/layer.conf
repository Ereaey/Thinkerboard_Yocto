## layers/meta-assistant/conf/layer.conf
```bitbake
# We have a conf and classes directory, add to BBPATH
BBPATH .= ":${LAYERDIR}"

# We have recipes-* directories, add to BBFILES
BBFILES += "${LAYERDIR}/recipes-*/*/*.bb \
	    ${LAYERDIR}/recipes-*/*/*.bbappend"

LAYERDEPENDS_rockchip = "core openembedded-layer"

# This should only be incremented on significant changes that will
# cause compatibility issues with other layers
LAYERVERSION_assistant = "1"
LAYERSERIES_COMPAT_assistant = "warrior zeus dunfell gatesgarth"
```
